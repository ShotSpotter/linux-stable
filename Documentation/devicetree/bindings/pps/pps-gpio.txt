## Documentation/devicetree/bindings/pps/pps-gpio.txt
```
Device-Tree Bindings for a PPS Signal on GPIO

These properties describe a PPS (pulse-per-second) signal connected to
a GPIO pin.

Required properties:
- compatible: should be "pps-gpio"
- gpios: one PPS GPIO in the format described by ../gpio/gpio.txt

Optional properties:
- assert-falling-edge: when present, assert is indicated by a falling edge
                       (instead of by a rising edge)
- capture-clear:       when present, capture both assert (start of timepulse) and
		       clear (end of timepulse) events. Usually desireable.

Example:
	pps {
		compatible = "pps-gpio";
		gpios = <&gpio2 6 0>;
		capture-clear;
		assert-falling-edge; /* atypical */
	};
```
